## examples/cubus_app/Kconfig
```kconfig
#
# For a description of the syntax of this configuration file,
# see the file kconfig-language.txt in the NuttX tools repository.
#

config EXAMPLES_CUBUS_APP
	tristate "CUBUS APP"
	default n
	---help---
		Enable the \"CUBUS APP \" 

if EXAMPLES_CUBUS_APP

config EXAMPLES_CUBUS_APP_PROGNAME
	string "Program name"
	default "Cubus"
	---help---
		This is the name of the program that will be used when the NSH ELF
		program is installed.

config EXAMPLES_CUBUS_USE_EXT_ADC
	bool "Use external ADC"
	default n
	---help---
		Select if we need to use the external ADC. 

config EXAMPLES_CUBUS_USE_INT_ADC
	bool "Use internal ADC"
	default n
	depends on ADC && BOARDCTL
	---help---
		Enable internal ADC for Cubus 

if EXAMPLES_CUBUS_USE_INT_ADC

config EXAMPLES_CUBUS_INT_ADC_DEVPATH
	string "ADC device path"
	default "/dev/adc0"
	---help---
		The default path to the ADC device. Default: /dev/adc0

config EXAMPLES_CUBUS_INT_ADC_NSAMPLES
	int "Number of Sample Groups"
	default 0
	---help---
		This number of samples is collected and the program terminates.
		Default:  0 (samples are collected indefinitely).

config EXAMPLES_CUBUS_INT_ADC_GROUPSIZE
	int "Number of Samples per Group"
	default 4
	---help---
		The number of samples to read at once. Default: 4

config EXAMPLES_CUBUS_INT_ADC_SWTRIG
	bool "Use software trigger"
	default n
	---help---
		Some ADCs may be configured so there is no automatic or periodic
		conversion of samples.  Rather, the ADC sampling must be trigger by
		software via an ioctl command.  Select this option only if
		applicable for your ADC configuration.  In this case, the test will
		issue the software trigger ioctl before attempting to read from the
		ADC.

endif

config EXAMPLES_CUBUS_APP_PRIORITY
	int "Cubus app task priority"
	default 100

config EXAMPLES_CUBUS_APP_STACKSIZE
	int "Cubus_app stack size"
	default DEFAULT_TASK_STACKSIZE

endif
```
